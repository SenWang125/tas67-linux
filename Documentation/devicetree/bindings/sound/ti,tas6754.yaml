## Documentation/devicetree/bindings/sound/ti,tas6754.yaml
```yaml
# SPDX-License-Identifier: (GPL-2.0-only OR BSD-2-Clause)
%YAML 1.2
---
$id: http://devicetree.org/schemas/sound/ti,tas6754.yaml#
$schema: http://devicetree.org/meta-schemas/core.yaml#

title: Texas Instruments TAS6754 Audio Amplifier

maintainers:
  - Sen Wang <sen@ti.com>

description:
  The TAS6754 is a four-channel, digital-input, automotive Class-D audio
  amplifier with load diagnostics and an integrated DSP for audio processing.
  It supports I2S and TDM serial audio interfaces.
allOf:
  - $ref: dai-common.yaml#

properties:
  compatible:
    enum:
      - ti,tas6754

  reg:
    maxItems: 1

  '#sound-dai-cells':
    const: 1
    description: |
      The device exposes three DAIs, selected by index.
        0 - Standard Audio Path (Playback)
        1 - Low-Latency Playback Path (Playback)
        2 - Sensory Feedback (Capture - Vpredict and Isense)
      By default, all four channels of each DAI are active. Runtime
      reconfiguration is available through DAPM widgets.

  interrupts:
    maxItems: 1
    description:
      Active-low falling-edge interrupt from the FAULT pin. When provided,
      the driver uses IRQ-driven fault reporting instead of polling.

  pd-gpios:
    maxItems: 1
    description:
      GPIO connected to the power-down (PD#) pin, active low. Controls the
      internal digital circuitry power state. When asserted the device enters
      full power-down mode and all register state is lost.

  stby-gpios:
    maxItems: 1
    description:
      GPIO connected to the standby (STBY#) pin, active low. Controls the
      analog power stage. When asserted the device enters Deep Sleep mode
      but remains I2C-accessible with registers retained.

  dvdd-supply:
    description:
      Regulator for digital logic supply (typically 1.8V or 3.3V).
      Optional, but highly recommended to include, even in forms of dummy
      regulators.

  pvdd-supply:
    description:
      Regulator for power stage supply (4.5V to 19V). Optional, but highly
      recommended to include, even in forms of dummy regulators.

  vbat-supply:
    description:
      Regulator for battery/power supply for the Class-D output stage.
      Optional, but highly recommended to include, even in forms of dummy
      regulators.

  ti,fast-boot:
    type: boolean
    description:
      Skip DC load diagnostic sweep at power-on to reduce boot latency.
      Automatic diagnostics after fault conditions remain enabled. Hardware
      overcurrent protection is always active.

  ti,audio-slot-no:
    $ref: /schemas/types.yaml#/definitions/uint32
    description:
      TDM slot offset for the standard audio playback path (SDIN). A value
      of 4 maps to slot 4. If omitted, slot assignment is derived from the
      tx_mask provided via set_tdm_slot(). Without either property, no slot
      mapping is configured.

  ti,llp-slot-no:
    $ref: /schemas/types.yaml#/definitions/uint32
    description:
      TDM slot offset for the low-latency playback path (SDIN). If omitted,
      slot assignment is derived from the tx_mask provided via
      set_tdm_slot(). Without either property, no slot mapping is
      configured.

  ti,vpredict-slot-no:
    $ref: /schemas/types.yaml#/definitions/uint32
    description:
      TDM slot number for voltage prediction feedback on SDOUT. Four
      consecutive slots are used starting at this position.

  ti,isense-slot-no:
    $ref: /schemas/types.yaml#/definitions/uint32
    description:
      TDM slot number for current sense feedback on SDOUT. Four
      consecutive slots are used starting at this position.

  ti,gpio1-function:
    $ref: /schemas/types.yaml#/definitions/string
    description: |
      Function for the GPIO_1 pin.
      Output functions (low through high) configure the pin as an output
      driving the selected signal:
        low           - output driven low
        auto-mute     - high when all channels are auto-muted
        auto-mute-ch4 - high when channel 4 is auto-muted
        auto-mute-ch3 - high when channel 3 is auto-muted
        auto-mute-ch2 - high when channel 2 is auto-muted
        auto-mute-ch1 - high when channel 1 is auto-muted
        sdout2        - secondary serial data output 2
        sdout1        - secondary serial data output 1
        warn          - warning signal output (OTW, CBC)
        fault         - fault signal output (OTSD, OC, DC)
        clock-sync    - clock synchronisation output
        invalid-clock - high when clock is invalid
        high          - output driven high
      Input functions (mute through sleep) configure the pin as an input
      receiving an external trigger:
        mute          - external mute control
        phase-sync    - phase synchronisation input
        sdin2         - SDIN2 pin, not supported in the current driver but
                        reserved for future use
        deep-sleep    - asserted transitions device to Deep Sleep state
        hiz           - asserted transitions device to Hi-Z state
        play          - asserted transitions device to Play state
        sleep         - asserted transitions device to Sleep state
      When omitted, GPIO_1 remains in its power-on default state.
    enum:
      - low
      - auto-mute
      - auto-mute-ch4
      - auto-mute-ch3
      - auto-mute-ch2
      - auto-mute-ch1
      - sdout2
      - sdout1
      - warn
      - fault
      - clock-sync
      - invalid-clock
      - high
      - mute
      - phase-sync
      - sdin2
      - deep-sleep
      - hiz
      - play
      - sleep

  ti,gpio2-function:
    $ref: /schemas/types.yaml#/definitions/string
    description: |
      Function for the GPIO_2 pin. Same values as ti,gpio1-function.
      When omitted, GPIO_2 remains in its power-on default state.
    enum:
      - low
      - auto-mute
      - auto-mute-ch4
      - auto-mute-ch3
      - auto-mute-ch2
      - auto-mute-ch1
      - sdout2
      - sdout1
      - warn
      - fault
      - clock-sync
      - invalid-clock
      - high
      - mute
      - phase-sync
      - sdin2
      - deep-sleep
      - hiz
      - play
      - sleep

  ports:
    $ref: /schemas/graph.yaml#/properties/ports
    properties:
      port@0:
        $ref: audio-graph-port.yaml#
        unevaluatedProperties: false
        description: Standard audio playback port (DAI 0).

      port@1:
        $ref: audio-graph-port.yaml#
        unevaluatedProperties: false
        description: Low-latency playback port (DAI 1).

      port@2:
        $ref: audio-graph-port.yaml#
        unevaluatedProperties: false
        description: Sensory feedback capture port (DAI 2).

  port:
    $ref: audio-graph-port.yaml#
    unevaluatedProperties: false

required:
  - compatible
  - reg
  - '#sound-dai-cells'

anyOf:
  - required: [pd-gpios]
  - required: [stby-gpios]

unevaluatedProperties: false

examples:
  - |
    #include <dt-bindings/gpio/gpio.h>

    i2c {
        #address-cells = <1>;
        #size-cells = <0>;

        amplifier@70 {
            compatible = "ti,tas6754";
            reg = <0x70>;
            #sound-dai-cells = <1>;
            sound-name-prefix = "TAS0";

            stby-gpios = <&main_gpio0 33 GPIO_ACTIVE_LOW>;

            dvdd-supply = <&dvdd_1v8>;
            pvdd-supply = <&pvdd_12v>;
            vbat-supply = <&vbat_12v>;

            ti,audio-slot-no = <0>;
            ti,llp-slot-no = <4>;
            ti,vpredict-slot-no = <0>;
            ti,isense-slot-no = <4>;

            ti,gpio2-function = "warn";

            ports {
                #address-cells = <1>;
                #size-cells = <0>;

                port@0 {
                    reg = <0>;

                    tas0_audio_ep: endpoint {
                        dai-format = "dsp_b";
                        remote-endpoint = <&be_tas0_audio_ep>;
                    };
                };

                port@1 {
                    reg = <1>;

                    tas0_anc_ep: endpoint {
                        remote-endpoint = <&be_tas0_anc_ep>;
                    };
                };

                port@2 {
                    reg = <2>;

                    tas0_fb_ep: endpoint {
                        remote-endpoint = <&be_tas0_fb_ep>;
                    };
                };
            };
        };
    };
```
